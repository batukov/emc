//
// Created by diehigh on 17.09.18.
//

#include <stm32f405xx.h>
//#include <stm32f4xx_hal_tim.h>
#include "my_class.h"
#include "tim.h"
#include "stm32f4xx_hal.h"
#include "math.h"
#include "vector"
#include "algorithm"
#include "../Inc/my_class.h"


#define pi 3.1415926535F
extern volatile uint16_t ADC_data[4];
extern ADC_HandleTypeDef hadc1;
extern ADC_HandleTypeDef hadc2;
extern uint32_t tim4_counter;

__attribute__ ((section (".userRam")))
uint32_t sinful_array[100][51] = {
        0,2,3,4,6,7,9,10,12,13,14,15,16,17,18,19,20,21,22,22,23,23,24,24,24,24,24,24,24,23,23,22,22,21,20,19,19,18,16,15,14,13,12,10,9,7,6,5,3,2,0,
        0,2,4,5,7,9,10,12,13,15,16,18,19,20,22,23,24,25,25,26,27,27,27,28,28,28,28,28,27,27,27,26,25,25,24,23,22,20,19,18,16,15,14,12,10,9,7,5,4,2,0,
        0,2,4,6,8,10,12,14,15,17,19,20,22,23,25,26,27,28,29,30,30,31,31,32,32,32,32,32,31,31,30,30,29,28,27,26,25,23,22,20,19,17,15,14,12,10,8,6,4,2,0,
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        0,26,53,79,105,130,155,179,202,225,247,268,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1
};

__attribute__ ((section (".userRam")))
float sin_a[20] = {0, 0.0523, 0.1045, 0.1564, 0.2078, 0.2587, 0.3089, 0.3582, 0.4065, 0.4538, 0.4998, 0.5444, 0.5875, 0.6291, 0.6689, 0.7068, 0.7429, 0.7769, 0.8087, 0.8384};
float sin_b[20] = {0.8658, 0.8908, 0.9133, 0.9334, 0.9509, 0.9658, 0.978, 0.9876, 0.9944, 0.9986, 1, 0.9987, 0.9946, 0.9878, 0.9783, 0.9662, 0.9514, 0.9339, 0.914, 0.8915};
float sin_c[20] = {0.8666, 0.8393, 0.8097, 0.7779, 0.7439, 0.708, 0.67, 0.6303, 0.5888, 0.5457, 0.5011, 0.4552, 0.408, 0.3597, 0.3104, 0.2602, 0.2094, 0.1579, 0.1061, 0.0539};
float sin_d[20] = {0.0016, -0.0507, -0.1029, -0.1548, -0.2062, -0.2572, -0.3074, -0.3567, -0.4051, -0.4524, -0.4984, -0.5431, -0.5862, -0.6278, -0.6677, -0.7057, -0.7418, -0.7759, -0.8078, -0.8375};
float sin_e[20] = {-0.865, -0.89, -0.9127, -0.9328, -0.9504, -0.9653, -0.9777, -0.9873, -0.9943, -0.9985, -1, -0.9988, -0.9948, -0.9881, -0.9787, -0.9666, -0.9518, -0.9345, -0.9146, -0.8922};
float sin_f[20] = {-0.8673, -0.8401, -0.8106, -0.7789, -0.745, -0.7091, -0.6712, -0.6315, -0.5901, -0.5471, -0.5025, -0.4566, -0.4095, -0.3612, -0.3119, -0.2618, -0.2109, -0.1595, -0.1076, -0.0555};

float cos_a[20] = {0.9986, 0.9945, 0.9877, 0.9782, 0.966, 0.9511, 0.9336, 0.9136, 0.8911, 0.8662, 0.8388, 0.8092, 0.7774, 0.7434, 0.7074, 0.6694, 0.6297, 0.5882, 0.5451, 0.5005};
float cos_b[20] = {0.4545, 0.4073, 0.3589, 0.3096, 0.2595, 0.2086, 0.1571, 0.1053, 0.0531, 0.0008, -0.0515, -0.1037, -0.1556, -0.207, -0.2579, -0.3081, -0.3575, -0.4058, -0.4531, -0.4991};
float cos_c[20] = {-0.5437, -0.5869, -0.6284, -0.6683, -0.7063, -0.7423, -0.7764, -0.8083, -0.838, -0.8654, -0.8904, -0.913, -0.9331, -0.9506, -0.9655, -0.9778, -0.9875, -0.9944, -0.9985, -1};
float cos_d[20] = {-0.9987, -0.9947, -0.9879, -0.9785, -0.9664, -0.9516, -0.9342, -0.9143, -0.8918, -0.867, -0.8397, -0.8101, -0.7784, -0.7445, -0.7085, -0.6706, -0.6309, -0.5895, -0.5464, -0.5018};
float cos_e[20] = {-0.4559, -0.4087, -0.3604, -0.3111, -0.261, -0.2101, -0.1587, -0.1069, -0.0547, -0.0024, 0.0499, 0.1021, 0.154, 0.2055, 0.2564, 0.3066, 0.356, 0.4044, 0.4516, 0.4977};
float cos_f[20] = {0.5424, 0.5856, 0.6272, 0.6671, 0.7051, 0.7413, 0.7754, 0.8073, 0.8371, 0.8646, 0.8897, 0.9123, 0.9325, 0.9501, 0.9651, 0.9775, 0.9872, 0.9942, 0.9985, 1};

sin_cos get_sin_cos(float pos, int state){
    sin_cos result = {0.0F, 0.0F};
    int element = int(pos*20.0F) - 1;
    switch(state){
        case 0:
            result.sin_val = sin_a[element];
            result.cos_val = cos_a[element];
            break;
        case 1:
            result.sin_val = sin_b[element];
            result.cos_val = cos_b[element];
            break;
        case 2:
            result.sin_val = sin_c[element];
            result.cos_val = cos_c[element];
            break;
        case 3:
            result.sin_val = sin_d[element];
            result.cos_val = cos_d[element];
            break;
        case 4:
            result.sin_val = sin_e[element];
            result.cos_val = cos_e[element];
            break;
        case 5:
            result.sin_val = sin_f[element];
            result.cos_val = cos_f[element];
            break;
        default:
            break;
    }
    return result;
}

uint32_t get_sin(float ampl, float time){
    uint32_t x = uint32_t(ampl*100);
    uint32_t y = uint32_t(time*50);
    uint32_t aa = sinful_array[x][y];
    return aa;
}

my_class::my_class(int time){
    BaseType_t val = xTaskCreate( this->morgat_blyat,
                 "ya_mon",
                 15000,
                 (void *)this,
                 1,
                 nullptr );
    this->expected_switch_time = xTaskGetTickCount() + 1000;
    this->lasst_time = 0;
}

void my_class::kirhgoff(int val_1, int val_2) {

    this->cur_clear_1 = val_1-2048;
    this->cur_clear_2 = val_2-2048;
    this->cur_clear_3 = -val_1 - val_2 + 4096;
}

void my_class::forward_clark() {
    this->cur_a = (float)this->cur_clear_1;
    this->cur_b = 0.577*((float)this->cur_clear_1 + 2*(float)this->cur_clear_2);
}

void my_class::forward_park() {
    sin_cos aa = get_sin_cos(this->angle, this->state_handler);
    //this->cur_d =  this->cur_a*cosf(this->angle) + this->cur_b*sinf(this->angle);
    //this->cur_q = -this->cur_a*sinf(this->angle) + this->cur_b*cosf(this->angle);
    this->cur_d =  this->cur_a*aa.cos_val + this->cur_b*aa.sin_val;
    this->cur_q = -this->cur_a*aa.sin_val + this->cur_b*aa.cos_val;
    //int hhasdh = 0;
}
void my_class::pid_d() {
    float delta = target_d - this->cur_d;
    this->vol_d_p = delta * P_d + this->vol_d_i * I_d;
    this->vol_d_i += delta;
}
void my_class::pid_q() {
    float delta = target_q - this->cur_q;
    this->vol_q_p = delta * P_q + this->vol_q_i * I_q;
    this->vol_q_i += delta;
}
void my_class::backward_park() {
    sin_cos aa = get_sin_cos(this->angle, this->state_handler);
    this->vol_d_sup = vol_d_p*aa.cos_val - vol_q_p*aa.sin_val;
    this->vol_q_sup = vol_d_p*aa.sin_val + vol_q_p*aa.cos_val;
    //this->vol_d_sup = vol_d_p*cosf(this->angle) - vol_q_p*sinf(this->angle);
    //this->vol_q_sup = vol_d_p*sinf(this->angle) + vol_q_p*cosf(this->angle);
}
void my_class::backward_clark() {
    this->vol_a =  this->vol_d_sup;
    this->vol_b = -0.5F*this->vol_d_sup + 0.865F*this->vol_q_sup;
    this->vol_c = -0.5F*this->vol_d_sup - 0.865F*this->vol_q_sup;
}
int my_class::compare(const void * x1, const void * x2)   // функция сравнения элементов массива
{
    return ( *(float*)x1 - *(float*)x2 );              // если результат вычитания равен 0, то числа равны, < 0: x1 < x2; > 0: x1 > x2
}
float my_class::median_filter(float* array, int array_size){
    float temp_array[array_size];
    memcpy(temp_array, array, sizeof(float)*array_size);
    qsort(temp_array,array_size,sizeof(float), this->compare);
    return temp_array[int(array_size/2) - 1];
}
void my_class::set_width_new_way(float ampl, float time, int channel) {
    float changed_time = time*0.5F;
    switch(channel) {
        case 0:
            htim1.Instance->CCR1 = 0;
            htim1.Instance->CCR2 = get_sin(ampl, (changed_time + 0.5F));
            htim1.Instance->CCR3 = get_sin(ampl, changed_time);
            break;
        case 1:
            htim1.Instance->CCR1 = get_sin(ampl, changed_time);
            htim1.Instance->CCR2 = 0;
            htim1.Instance->CCR3 = get_sin(ampl, (changed_time + 0.5F));
            break;
        case 2:
            htim1.Instance->CCR1 = get_sin(ampl, (changed_time+ 0.5F));
            htim1.Instance->CCR2 = get_sin(ampl, changed_time);
            htim1.Instance->CCR3 = 0;
            break;
    }
}

void State::set_next_state(State* next)
{
    this->next_state = next;
}



void my_class::morgat_blyat(void *pvParameters){
    const int buf_size = 1000;
    int buf_counter = 0;

    float temp_1[500] = {0.0F};
    float temp_2[500] = {0.0F};
    float temp_3[500] = {0.0F};
    float temp_4[500] = {0.0F};
    //float temp_4[1000] = {0.0F};
    int temp_counter = 0;

    uint32_t  adc[4] = {0};
    uint32_t  adc_v[4] = {0};
    float amplitude = 0.1F;
    uint32_t current_adc[buf_size] = {0};

    my_class *obj = (my_class * )pvParameters;

    //State TEST(1,0,-1,false, nullptr);

    State F( 1, 0,-1, false, nullptr, 5);
    State E( 0, 1,-1, true,  &F, 4);
    State D(-1, 1, 0, false, &E, 3);
    State C(-1, 0, 1, true,  &D, 2);
    State B( 0,-1, 1, false, &C, 1);
    State A( 1,-1, 0, true,  &B, 0);
    F.set_next_state(&A);

    State* current_state = &A;
    obj->state_handler = current_state->state_h;

    HAL_GPIO_WritePin(GPIOC,GPIO_PIN_10,GPIO_PIN_SET);
    HAL_GPIO_WritePin(GPIOB,GPIO_PIN_12,GPIO_PIN_RESET);


    // нессущая чистота 84000, предделитель 8399, период 10000,длина импульса всякая там
    HAL_TIM_PWM_Start(&htim1, TIM_CHANNEL_1);    //starts PWM on CH1 pin
    HAL_TIMEx_PWMN_Start(&htim1, TIM_CHANNEL_1); //starts PWM on CH1N pin

    HAL_TIM_PWM_Start(&htim1, TIM_CHANNEL_2);    //starts PWM on CH1 pin
    HAL_TIMEx_PWMN_Start(&htim1, TIM_CHANNEL_2); //starts PWM on CH1N pin

    HAL_TIM_PWM_Start(&htim1, TIM_CHANNEL_3);    //starts PWM on CH1 pin
    HAL_TIMEx_PWMN_Start(&htim1, TIM_CHANNEL_3); //starts PWM on CH1N pin

    htim1.Instance->CCR1 = 0;
    htim1.Instance->CCR2 = 0;
    htim1.Instance->CCR3 = 0;

    TickType_t end_time = 0;

    uint32_t expected_switch_time_t = 0;
    float period = 1;
    uint32_t current_time = 0;
    float pos_on_period = 0.0F;
    period = 2500;
    //State Test_one(0,0,0,false,nullptr);
    uint32_t switch_time = 0;
    const int adc_array_size = 7;
    float adc_array_a[adc_array_size] = {0.0F};
    float adc_array_b[adc_array_size] = {0.0F};
    int adc_array_counter = 0;
    bool do_switch = false;
    int add_counter = 0;
    while(1)
    {
        if(!do_switch) {


            adc_v[0] = ADC1->JDR4;
            adc_v[1] = ADC1->JDR3;//3
            adc_v[2] = ADC1->JDR2;//2
            adc_v[3] = ADC1->JDR1;//1
            ADC1->CR2 |= ADC_CR2_JSWSTART;

            adc[0] = ADC2->JDR1;
            adc[1] = ADC2->JDR2;
            ADC2->CR2 |= ADC_CR2_JSWSTART;

            /*current_adc[buf_counter] = adc[0];
            buf_counter++;
            if(buf_counter == buf_size)
            {
                buf_counter = 0;
            }
    */

            temp_1[temp_counter] = adc_v[1];
            temp_2[temp_counter] = adc_v[2];
            temp_3[temp_counter] = adc_v[3];
            temp_4[temp_counter] = htim1.Instance->CCR1;
            adc_array_a[adc_array_counter] = adc[0];
            adc_array_b[adc_array_counter] = adc[1];
            adc_array_counter++;
            if (adc_array_counter == adc_array_size) { adc_array_counter = 0; }
            //temp_1[temp_counter] = adc[0];
            //temp_2[temp_counter] = adc[1];
            //temp_counter++;


            current_time = get_time();
            pos_on_period = (((float) current_time - (float) end_time) / (float) period);
            if (pos_on_period > 1.0F) { pos_on_period = 1.0F; }
            obj->angle = pos_on_period;
            float val_1 = obj->median_filter(adc_array_a, adc_array_size);
            float val_2 = obj->median_filter(adc_array_b, adc_array_size);
            //obj->kirhgoff(adc[0], adc[1]);
            obj->kirhgoff(val_1, val_2);
            obj->forward_clark();
            obj->forward_park();
            obj->pid_d();
            obj->pid_q();
            obj->backward_park();
            obj->backward_clark();

            //temp_1[temp_counter] = obj->vol_a + 0.4F;// + 220;
            //temp_2[temp_counter] = obj->vol_b + 0.6F;// + 550;
            //temp_3[temp_counter] = obj->vol_c - 1.0F;// + 90;
            //temp_1[temp_counter] = obj->cur_d;// + 90;
            //temp_2[temp_counter] = obj->cur_q;
            //temp_1[temp_counter] = obj->cur_q;
            //temp_1[temp_counter] = htim1.Instance->CCR1;
            //temp_1[temp_counter] = val_1;
            //temp_2[temp_counter] = adc[0];
            temp_counter++;
            if (temp_counter == 500) {
                temp_counter = 0;
                add_counter++;
            }


            obj->set_width_new_way(amplitude, pos_on_period, current_state->wiring);
            //obj->set_state(current_state);
            if (current_time >= expected_switch_time_t) {
                current_state = current_state->next_state;
                obj->state_handler = current_state->state_h;
                expected_switch_time_t = current_time + period;
                end_time = current_time;
                switch_time = end_time;
                if(add_counter > 10)
                {do_switch = false;}
            }
        }else{
            adc_array_a[adc_array_counter] = adc[0];
            adc_array_b[adc_array_counter] = adc[1];
            adc_array_counter++;
            if (adc_array_counter == adc_array_size) { adc_array_counter = 0; }
            //temp_1[temp_counter] = adc[0];
            //temp_2[temp_counter] = adc[1];
            //temp_counter++;


            current_time = get_time();
            pos_on_period = (((float) current_time - (float) end_time) / (float) period);
            if (pos_on_period > 1.0F) { pos_on_period = 1.0F; }
            obj->angle = pos_on_period;
            float val_1 = obj->median_filter(adc_array_a, adc_array_size);
            float val_2 = obj->median_filter(adc_array_b, adc_array_size);
            obj->kirhgoff(val_1, val_2);
            obj->forward_clark();
            obj->forward_park();
            obj->pid_d();
            obj->pid_q();
            obj->backward_park();
            obj->backward_clark();

            obj->vol_a += 4.4F;//0.4F;
            obj->vol_b += 4.6F;//0.6F;
            obj->vol_c += 3.0F;//-= 1.0F;

            obj->vol_a *= 20;
            obj->vol_b *= 20;
            obj->vol_c *= 20;
            if(obj->vol_c < 0){obj->vol_c = 0;}

            htim1.Instance->CCR1 = (int)obj->vol_a;
            htim1.Instance->CCR2 = (int)obj->vol_b;
            htim1.Instance->CCR3 = (int)obj->vol_c;
        }
    }
}